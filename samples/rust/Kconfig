## samples/rust/Kconfig
```kconfig
# SPDX-License-Identifier: GPL-2.0

menuconfig SAMPLES_RUST
	bool "Rust samples"
	depends on RUST
	help
	  You can build sample Rust kernel code here.

	  If unsure, say No.

if SAMPLES_RUST

config SAMPLE_RUST_MINIMAL
	tristate "Minimal Rust Config"
	help
	  This option builds the Rust minimal module sample.

	  To compile this as a module, choose M here:
	  the module will be called rust_minimal.

	  If unsure, say No.

config SAMPLE_RUST_PRINT
	tristate "Printing macros"
	help
	  This option builds the Rust printing macros sample.

	  To compile this as a module, choose M here:
	  the module will be called rust_print.

	  If unsure, say No.

config SAMPLE_RUST_HOSTPROGS
	bool "Host programs for rust"
	help
	  This option builds the Rust host program samples.

	  If unsure, say No.

endif # SAMPLES_RUST
```
